#include <PS2Keyboard.h>
#include <Talkie.h>

const uint8_t spA[]             PROGMEM = {0x65, 0x2C, 0x96, 0xAD, 0x7B, 0x6A, 0x9F, 0x66, 0xE4, 0x20, 0x8D, 0x9C, 0x73,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 0xFF, 0x3F};
const uint8_t spB[]             PROGMEM = {0xA6, 0x2F, 0xAA, 0x05, 0x5C, 0xD6, 0x8C, 0xBC, 0xC7, 0x16, 0x70, 0x59, 0x33,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 0xFF, 0x03};
const uint8_t spC[]             PROGMEM = {0x04, 0xF8, 0xA5, 0x83, 0x03, 0x12, 0xB0, 0x80, 0x07, 0x22, 0xB0, 0xC2, 0xEE,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 0xF3, 0xFF};
const uint8_t spD[]             PROGMEM = {0x06, 0x98, 0x30, 0x68, 0xE4, 0x6B, 0x84, 0xA0, 0xE8, 0xD3, 0x93, 0x8D, 0xEC,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 0xFF, 0x0F};
const uint8_t spE[]             PROGMEM = {0xA2, 0x59, 0x95, 0x51, 0xBA, 0x17, 0xF7, 0x6A, 0x95, 0xAB, 0x38, 0x42, 0xE4,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 0xFF, 0x07};
const uint8_t spF[]             PROGMEM = {0xAB, 0x1B, 0x61, 0x94, 0xDD, 0xD6, 0xDC, 0xF1, 0x74, 0xDD, 0x37, 0xB9, 0xE7,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 0xFF, 0x07};
const uint8_t spG[]             PROGMEM = {0x6E, 0x3F, 0x29, 0x8D, 0x98, 0x95, 0xCD, 0x3D, 0x00, 0xAB, 0x38, 0x95, 0xE2,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 0xF9, 0x7F};
const uint8_t spH[]             PROGMEM = {0x65, 0x18, 0x6D, 0x90, 0x2D, 0xD6, 0xEC, 0xF6, 0x56, 0xB7, 0xBC, 0xC5, 0xAE,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 0xFE, 0x1F};
const uint8_t spI[]             PROGMEM = {0xAA, 0x8D, 0x63, 0xA8, 0xAA, 0x66, 0xAD, 0xB9, 0xA8, 0xCB, 0x08, 0xDD, 0x7C,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 0xFE, 0x7F};
const uint8_t spL[]             PROGMEM = {0x6B, 0x68, 0x2E, 0xD8, 0x2A, 0x37, 0xDF, 0xFE, 0xF6, 0xA7, 0xAF, 0x21, 0xBC,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 0xFF, 0x0F};
const uint8_t spJ[]             PROGMEM = {0x6E, 0x5A, 0xC1, 0x99, 0x54, 0xB2, 0x09, 0x60, 0x49, 0x22, 0x07, 0xEC, 0xA8,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 0xFF, 0x07};
const uint8_t spK[]             PROGMEM = {0x01, 0x18, 0x91, 0xB9, 0x00, 0x4D, 0x91, 0x46, 0x60, 0x65, 0x2D, 0xB3, 0xB8,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 0xFF, 0x01};
const uint8_t spM[]             PROGMEM = {0xA9, 0xE8, 0xC5, 0xD8, 0x73, 0x16, 0xCF, 0xE2, 0x0E, 0xB7, 0xBB, 0xCD, 0xA9,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 0xFF, 0x07};
const uint8_t spN[]             PROGMEM = {0x41, 0xEE, 0xD1, 0xC8, 0xB3, 0x16, 0xEF, 0xEE, 0xD4, 0xC3, 0x35, 0x59, 0xC4,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 0xFF, 0x01};
const uint8_t spO[]             PROGMEM = {0xA3, 0x6D, 0xB4, 0xBA, 0x8D, 0xBC, 0xAD, 0xA6, 0x92, 0xEC, 0x0E, 0xF2, 0xB6,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 0xFF, 0x01};
const uint8_t spP[]             PROGMEM = {0x02, 0x88, 0x26, 0xD4, 0x00, 0x6D, 0x96, 0xB5, 0xB8, 0x25, 0x05, 0x89, 0x6C,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 0xFE, 0x3F};
const uint8_t spQ[]             PROGMEM = {0x0E, 0x98, 0xD5, 0x28, 0x02, 0x11, 0x18, 0xE9, 0xCC, 0x46, 0x98, 0xF1, 0x66,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 0xFF, 0x0F};
const uint8_t spR[]             PROGMEM = {0xAB, 0xC8, 0x72, 0x33, 0x93, 0xBB, 0xDC, 0xEE, 0xB6, 0xB7, 0xB9, 0xF5, 0x68,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 0xFD, 0x3F};
const uint8_t spS[]             PROGMEM = {0x6B, 0x6E, 0xD9, 0x34, 0x6C, 0xE6, 0xDC, 0xF6, 0x36, 0xB7, 0xBE, 0xF5, 0x19,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 0xF0, 0xFF};
const uint8_t spT[]             PROGMEM = {0x01, 0xD8, 0xB6, 0xDD, 0x01, 0x2F, 0xF4, 0x38, 0x60, 0xD5, 0xD1, 0x91, 0x4D,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 0xFF, 0x07};
const uint8_t spU[]             PROGMEM = {0xA1, 0x9F, 0x9C, 0x94, 0x72, 0x26, 0x8D, 0x76, 0x07, 0x55, 0x90, 0x78, 0x3C,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 0xFF, 0x01};
const uint8_t spV[]             PROGMEM = {0x66, 0xF3, 0xD2, 0x38, 0x43, 0xB3, 0xD8, 0x2D, 0xAC, 0x4D, 0xBB, 0x70, 0xB0,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 0xFF, 0x03};
const uint8_t spW[]             PROGMEM = {0xA1, 0xDE, 0xC2, 0x44, 0xC2, 0xFC, 0x9C, 0x6A, 0x88, 0x70, 0x09, 0x59, 0x7B,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 0xFF, 0x07};
const uint8_t spX[]             PROGMEM = {0xAD, 0x68, 0xC9, 0xC5, 0x32, 0x56, 0xDF, 0xFA, 0x54, 0x2D, 0x35, 0x7B, 0xF8,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 0xFE, 0x1F};
const uint8_t spY[]             PROGMEM = {0x6A, 0xB1, 0xA2, 0xA7, 0x95, 0xD2, 0xD8, 0x25, 0x0F, 0xA3, 0x2D, 0xB2, 0x7A,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 0xFA, 0x7F};
const uint8_t spZ[]             PROGMEM = {0x6D, 0xFD, 0xC6, 0x5C, 0x95, 0xD5, 0xF5, 0xD5, 0x02, 0x7B, 0x5D, 0xFD, 0x51,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 0xFE, 0x1F};

const uint8_t spZERO[]          PROGMEM = {0x69, 0xFB, 0x59, 0xDD, 0x51, 0xD5, 0xD7, 0xB5, 0x6F, 0x0A, 0x78, 0xC0, 0x52,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 0xFF, 0x1F};
const uint8_t spONE[]           PROGMEM = {0x66, 0x4E, 0xA8, 0x7A, 0x8D, 0xED, 0xC4, 0xB5, 0xCD, 0x89, 0xD4, 0xBC, 0xA2,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 0xFE, 0x1F};
const uint8_t spTWO[]           PROGMEM = {0x06, 0xB8, 0x59, 0x34, 0x00, 0x27, 0xD6, 0x38, 0x60, 0x58, 0xD3, 0x91, 0x55,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 0xFF, 0x1F};
const uint8_t spTHREE[]         PROGMEM = {0x0C, 0xE8, 0x2E, 0x94, 0x01, 0x4D, 0xBA, 0x4A, 0x40, 0x03, 0x16, 0x68, 0x69,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 0xFF, 0x03};
const uint8_t spFOUR[]          PROGMEM = {0x08, 0x68, 0x21, 0x0D, 0x03, 0x04, 0x28, 0xCE, 0x92, 0x03, 0x23, 0x4A, 0xCA,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 0xF2, 0xFF};
const uint8_t spFIVE[]          PROGMEM = {0x08, 0x68, 0x4E, 0x9D, 0x02, 0x1C, 0x60, 0xC0, 0x8C, 0x69, 0x12, 0xB0, 0xC0,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 0xFF, 0x01};
const uint8_t spSIX[]           PROGMEM = {0x04, 0xF8, 0xAD, 0x4C, 0x02, 0x16, 0xB0, 0x80, 0x06, 0x56, 0x35, 0x5D, 0xA8,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 0xFF, 0x01};
const uint8_t spSEVEN[]         PROGMEM = {0x0C, 0xF8, 0x5E, 0x4C, 0x01, 0xBF, 0x95, 0x7B, 0xC0, 0x02, 0x16, 0xB0, 0xC0,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 0xFB, 0x7F};
const uint8_t spEIGHT[]         PROGMEM = {0x65, 0x69, 0x89, 0xC5, 0x73, 0x66, 0xDF, 0xE9, 0x8C, 0x33, 0x0E, 0x41, 0xC6,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 0xF8, 0x7F};
const uint8_t spNINE[]          PROGMEM = {0xE6, 0xA8, 0x1A, 0x35, 0x5D, 0xD6, 0x9A, 0x35, 0x4B, 0x8C, 0x4E, 0x6B, 0x1A,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 0xFF, 0x0F};

const uint8_t spALPHA[]         PROGMEM = {0xAD, 0xED, 0x6A, 0xDC, 0x4B, 0x57, 0xEF, 0xF6, 0xB4, 0x53, 0x6C, 0x6A, 0x4B,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 0xFF, 0x01};
const uint8_t spBRAVO[]         PROGMEM = {0x61, 0x5A, 0xBA, 0xC2, 0xDD, 0x62, 0x85, 0xD6, 0xE8, 0x15, 0x59, 0xB1, 0x97,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 0xF3, 0xFF};
const uint8_t spCHARLIE[]       PROGMEM = {0x06, 0xD8, 0x2D, 0x2C, 0x01, 0x33, 0xB7, 0x67, 0x60, 0xC4, 0x35, 0x94, 0xAA,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 0xFE, 0x7F};
const uint8_t spDELTA[]         PROGMEM = {0x02, 0xE8, 0x54, 0x6D, 0xB5, 0x35, 0x84, 0xB9, 0xDA, 0x9A, 0x5B, 0x9F, 0xAA,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 0xFF, 0x03};
const uint8_t spECHO[]          PROGMEM = {0x2B, 0x6F, 0xB1, 0xD9, 0xD3, 0x36, 0xDF, 0xF6, 0x36, 0xB7, 0x26, 0x85, 0x08,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 0xFC, 0x7F};
const uint8_t spFOXTROT[]       PROGMEM = {0x08, 0x98, 0xB1, 0x53, 0x02, 0x1E, 0x88, 0xC0, 0xCA, 0x8B, 0xDA, 0x4A, 0x97,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 0xFF, 0x01};
const uint8_t spGOLF[]          PROGMEM = {0x0A, 0x88, 0xA1, 0x71, 0x15, 0x85, 0x76, 0x45, 0x8A, 0xFF, 0x9B, 0xDF, 0x6C,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 0xFF, 0x03};
const uint8_t spHENRY[]         PROGMEM = {0x08, 0xC8, 0x4A, 0x8C, 0x03, 0x1A, 0x68, 0x49, 0x0B, 0xAC, 0xE5, 0x11, 0xFA,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 0xF3, 0xFF};
const uint8_t spINDIA[]         PROGMEM = {0xA3, 0x9D, 0xD6, 0x99, 0x32, 0x17, 0xAF, 0x66, 0x86, 0x16, 0x74, 0x5F, 0x73,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 0xFF, 0xFF};
const uint8_t spJULIET[]        PROGMEM = {0x61, 0x5D, 0x96, 0x49, 0x34, 0xD2, 0x06, 0x60, 0xC7, 0x90, 0x0C, 0x8C, 0x66,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 0xFF, 0x07};
const uint8_t spKILO[]          PROGMEM = {0x06, 0xD8, 0x29, 0x25, 0x01, 0x5D, 0x22, 0x7B, 0xA0, 0x85, 0x33, 0x1A, 0x52,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 0xFD, 0x3F};
const uint8_t spLIMA[]          PROGMEM = {0x61, 0x5A, 0x90, 0xBA, 0xC0, 0xD7, 0xA6, 0x69, 0x00, 0x19, 0x85, 0x6A, 0xDA,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 0xFD, 0x7F};
const uint8_t spMIKE[]          PROGMEM = {0x66, 0x31, 0x3C, 0x7C, 0x52, 0xE3, 0xC4, 0x69, 0xF5, 0x85, 0x57, 0x86, 0x51,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 0xFE, 0x7F};
const uint8_t spNOVEMBER[]      PROGMEM = {0x6A, 0x2B, 0x02, 0x62, 0x4B, 0xE3, 0xDA, 0x75, 0x2C, 0x5D, 0x87, 0xB8, 0x73,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 0xFF, 0x0F};
const uint8_t spOSCAR[]         PROGMEM = {0x6B, 0xC8, 0xE2, 0xB2, 0x42, 0x3A, 0xDF, 0xFA, 0x16, 0x27, 0x4F, 0xAE, 0x7D,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 0xF9, 0x7F};
const uint8_t spPAPA[]          PROGMEM = {0x0A, 0x70, 0x4A, 0xB5, 0xA5, 0x45, 0x55, 0x84, 0x49, 0xCC, 0x93, 0x66, 0xD7,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 0xFF, 0x03};
const uint8_t spQUEBEC[]        PROGMEM = {0x0C, 0x88, 0x7E, 0x8C, 0x02, 0xA5, 0x0A, 0x31, 0xDD, 0x5C, 0xB2, 0xAC, 0x26,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 0xF8, 0x7F};
const uint8_t spROMEO[]         PROGMEM = {0xA2, 0xD5, 0x39, 0x38, 0xCA, 0xEC, 0xDB, 0xA5, 0x4C, 0xA1, 0x98, 0x5A, 0xB9,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 0xFF, 0x01};
const uint8_t spSIERRA[]        PROGMEM = {0x0C, 0xF8, 0xAD, 0xDC, 0x02, 0x1E, 0xB0, 0x80, 0x06, 0x4A, 0xDE, 0x7D, 0x90,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 0xFE, 0x7F};
const uint8_t spTANGO[]         PROGMEM = {0x0E, 0x58, 0x5A, 0xC3, 0x02, 0x27, 0xEB, 0xA1, 0xC4, 0x2B, 0x97, 0xDC, 0xF2,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 0xFF, 0x1F};
const uint8_t spUNIFORM[]       PROGMEM = {0x61, 0x3D, 0x56, 0x98, 0xD4, 0xB6, 0xE6, 0xA5, 0x8D, 0xC7, 0xA8, 0x01, 0xC5,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 0xFD, 0x3F};
const uint8_t spVICTOR[]        PROGMEM = {0x6E, 0x2D, 0xCA, 0xD8, 0x43, 0xD5, 0x99, 0xBD, 0x58, 0xE6, 0x70, 0xF1, 0x9A,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 0xFF, 0x07};
const uint8_t spWHISKY[]        PROGMEM = {0x04, 0x88, 0xAE, 0x8C, 0x03, 0x12, 0x08, 0x51, 0x74, 0x65, 0xE9, 0xEC, 0x68,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 0xFE, 0x3F};
const uint8_t spXRAY[]          PROGMEM = {0x69, 0xAE, 0xDE, 0x34, 0x3A, 0x6B, 0x9F, 0xAC, 0xA5, 0x66, 0x0F, 0x5F, 0x7D,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 0xFF, 0x01};
const uint8_t spYANKEE[]        PROGMEM = {0x6E, 0xEF, 0x42, 0x58, 0xB6, 0x6B, 0xA7, 0x7D, 0x68, 0x25, 0xCC, 0x59, 0xB4,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 0xFF, 0x01};
const uint8_t spZULU[]          PROGMEM = {0x6D, 0xFE, 0xDE, 0xC4, 0xC4, 0xE8, 0x29, 0x60, 0x00, 0x2E, 0x0F, 0x9C, 0x6C,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 0xFF, 0x07};


const uint8_t * letters[]  = {
  spA, spB, spC, spD, spE, spF, spG, spH, spI, spJ, spK, spL, spM, spN, spO,
  spP, spQ, spR, spS, spT, spU, spV, spW, spX, spY, spZ
};

const uint8_t * words[]  = {
  spALPHA, spBRAVO, spCHARLIE, spDELTA, spECHO, spFOXTROT, spGOLF, spHENRY, spINDIA,
  spJULIET, spKILO, spLIMA, spMIKE, spNOVEMBER, spOSCAR, spPAPA, spQUEBEC, spROMEO, spSIERRA,
  spTANGO, spUNIFORM, spVICTOR, spWHISKY, spXRAY, spYANKEE, spZULU
};

const uint8_t * numbers[]  = {
  spZERO, spONE, spTWO, spTHREE, spFOUR, spFIVE, spSIX, spSEVEN, spEIGHT, spNINE
};

const int DataPin = 4;
const int IRQpin =  3; //aka clock

PS2Keyboard keyboard;
Talkie voice;

void setup() {
  pinMode(5, OUTPUT);
  digitalWrite(5, HIGH);//Enable Amplified PROP shield

  delay(1000);
  keyboard.begin(DataPin, IRQpin);
  Serial.begin(9600);
  Serial.println("Keyboard Test:");
}

void loop() {
  if (keyboard.available()) {

    // read the next key
    char c = keyboard.read();

    // check for some of the special keys
    if (c == PS2_ENTER) {
      Serial.println();
    } else if (c == PS2_TAB) {
      Serial.print("[Tab]");
    } else if (c == PS2_ESC) {
      Serial.print("[ESC]");
    } else if (c == PS2_PAGEDOWN) {
      Serial.print("[PgDn]");
    } else if (c == PS2_PAGEUP) {
      Serial.print("[PgUp]");
    } else if (c == PS2_LEFTARROW) {
      Serial.print("[Left]");
    } else if (c == PS2_RIGHTARROW) {
      Serial.print("[Right]");
    } else if (c == PS2_UPARROW) {
      Serial.print("[Up]");
    } else if (c == PS2_DOWNARROW) {
      Serial.print("[Down]");
    } else if (c == PS2_DELETE) {
      Serial.print("[Del]");
    } else {

      // otherwise, just print all normal characters
      Serial.print(c);
      if (c >= 'a' && c <= 'z') {
        voice.say(letters[c - 'a']);
      } else if (c >= 'A' && c <= 'Z') {
        voice.say(words[c - 'A']);
      } else if (c >= '0' && c <= '9') {
        voice.say(numbers[c - '0']);
      }
    }
  }
}
